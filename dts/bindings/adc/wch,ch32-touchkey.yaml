## dts/bindings/adc/wch,ch32-touchkey.yaml
```yaml
# Copyright (c) 2026 Scott King
# SPDX-License-Identifier: Apache-2.0

description: WCH CH32 Touchkey Controller (reusing ADC)

compatible: "wch,ch32-touchkey"

include: adc-controller.yaml

properties:
  reg:
    required: true

  clocks:
    required: true

  interrupts:
    required: false

  "#io-channel-cells":
    const: 1

io-channel-cells:
  - input
```

## dts/bindings/can/wch,ch32-can.yaml
```yaml
# Copyright (c) 2025 Scott King
# SPDX-License-Identifier: Apache-2.0

description: WCH CH32 CAN controller

compatible: "wch,ch32-can"

include: can-controller.yaml

properties:
  reg:
    required: true

  interrupts:
    required: true

  clocks:
    required: true

  sample-point:
    type: int
    description: Sample point in permille (default 875)

  bitrate:
    type: int
    description: Bus speed in bits/s
    required: true

  bitrate-data:
    type: int
    description: Data phase bus speed in bits/s (for CAN FD)

  sample-point-data:
    type: int
    description: Data phase sample point in permille
```

## dts/bindings/clock/wch,ch32x035-rcc.yaml
```yaml
# Copyright (c) 2025 MASSDRIVER EI (massdriver.space)
# SPDX-License-Identifier: Apache-2.0

description: WCH CH32X035 Reset and Clock Control (RCC)

compatible: "wch,ch32x035-rcc"

include: [clock-controller.yaml, base.yaml]

properties:
  reg:
    required: true

  "#clock-cells":
    const: 1
    description: |
      Clock ID encoding: (bus_index << 5) | bit_position
      - bus_index 0 = AHB (AHBPCENR register)
      - bus_index 1 = APB2 (APB2PCENR register)
      - bus_index 2 = APB1 (APB1PCENR register)
      See dt-bindings/clock/ch32x035_clock.h for predefined clock IDs.

clock-cells:
  - id
```

## dts/bindings/comparator/wch,cmp.yaml
```yaml
# Copyright (c) 2026 Scott King
# SPDX-License-Identifier: Apache-2.0

description: WCH CMP (Comparator) sub-unit

compatible: "wch,cmp"

include: [base.yaml]

properties:
  index:
    type: int
    required: true
    description: CMP unit index (1, 2, or 3 typically)
```

## dts/bindings/crc/wch,ch32-crc.yaml
```yaml
# Copyright (c) 2026 Scott King
# SPDX-License-Identifier: Apache-2.0

description: WCH CH32 CRC Calculation Unit

compatible: "wch,ch32-crc"

include: base.yaml

properties:
  reg:
    required: true

  clocks:
    required: true
```

## dts/bindings/flash_controller/wch,ch32-flash-controller.yaml
```yaml
description: WCH CH32V20x/30x flash controller

compatible: "wch,ch32-flash-controller"

include: flash-controller.yaml

properties:
  reg:
    required: true
```

## dts/bindings/memory-controllers/wch,ch32-bbram.yaml
```yaml
# Copyright (c) 2024 WCH
# SPDX-License-Identifier: Apache-2.0

description: WCH Battery Backed RAM (BKP)

compatible: "wch,ch32-bbram"

include: base.yaml

properties:
  size:
    type: int
    required: true
    description: Size of BBRAM in bytes.
```

## dts/bindings/mfd/wch,opacmp.yaml
```yaml
# Copyright (c) 2024 WCH
# SPDX-License-Identifier: Apache-2.0

description: WCH CH32L103 OPACMP (Operational Amplifier and Comparator) MFD

compatible: "wch,opacmp"

include: [base.yaml]

properties:
  reg:
    required: true

  clocks:
    required: false

  interrupts:
    required: false
```

## dts/bindings/misc/wch,pwr.yaml
```yaml
# Copyright (c) 2024 WCH
# Copyright (c) 2026 Scott King
# SPDX-License-Identifier: Apache-2.0

description: WCH PWR (Power Control)

compatible: "wch,pwr"

include: base.yaml

properties:
  reg:
    required: true

  interrupts:
    required: false

  clocks:
    required: false

  pvd-level:
    type: int
    required: false
    description: |
      Programmable Voltage Detector (PVD) threshold level.
      Refer to specific SoC documentation for level-to-voltage mapping.
      Usually 0-7 or 0-3 depending on family.
```

## dts/bindings/opamp/wch,opa.yaml
```yaml
# Copyright (c) 2026 Scott King
# SPDX-License-Identifier: Apache-2.0

description: WCH OPA (Operational Amplifier) Child Node

compatible: "wch,opa"

include: [base.yaml]

properties:
  index:
    type: int
    required: true
    description: OPA index/number (0 for OPA1, etc.)

  gain:
    type: int
    required: false
    description: |
      PGA Gain setting.
      Allowed values: 1 (buffer), 2, 4, 8, 16, 32, 64.
      If not set, defaults to 1 (Buffer mode with external NSEL if not configured).
    enum: [1, 2, 4, 8, 16, 32, 64]

  input-positive:
    type: int
    required: false
    description: |
      Positive input MUX selection (PSEL).
      Value mapping depends on specific chip.
      0: CHP0
      1: CHP1
      ...
    default: 0

  input-negative:
    type: int
    required: false
    description: |
      Negative input MUX selection (NSEL).
      Used when Gain is 1 (or Manual mode).
      If Gain > 1, this property is ignored and internal resistors are used.
    default: 0
```

## dts/bindings/pwm/wch,ch32-lptim-pwm.yaml
```yaml
# Copyright (c) 2024 Scott King
# SPDX-License-Identifier: Apache-2.0

description: WCH CH32 LPTIM PWM

compatible: "wch,ch32-lptim-pwm"

include: [pwm-controller.yaml, base.yaml]

properties:
  "#pwm-cells":
    const: 3

pwm-cells:
  - channel
  - period
  - flags
```

## dts/bindings/pwm/wch,gptm-pwm.yaml
```yaml
# Copyright (c) 2025 Michael Hope <michaelh@juju.nz>
# SPDX-License-Identifier: Apache-2.0

description: WCH General-purpose Timer (GPTM) for PWM

compatible: "wch,gptm-pwm"

include: [base.yaml, pwm-controller.yaml, pinctrl-device.yaml]

properties:
  "#pwm-cells":
    const: 3

  prescaler:
    type: int
    required: true
    description: Clock prescaler value for the timer

  wch,repetition-counter:
    type: int
    description: |
      Repetition counter value (0-255).
      Only applies to advanced timers (TIM1).
      Defines the number of intermediate overflow/underflow events before an update event is generated.
      Equation -> Update_Event_Rate = (Event_Rate) / (RPTCR + 1)

pwm-cells:
  - channel
  - period
  - flags
```

## dts/bindings/rtc/wch,ch32-rtc.yaml
```yaml
# Copyright (c) 2024 WCH
# SPDX-License-Identifier: Apache-2.0

description: WCH RTC

compatible: "wch,ch32-rtc"

include: base.yaml

properties:
  reg:
    required: true

  interrupts:
    required: true

  clocks:
    required: true

  pwr-dev:
    type: phandle
    required: true
    description: Phandle to the PWR controller.
```

## dts/bindings/timer/wch,ch32-lptim.yaml
```yaml
# Copyright (c) 2026 Scott King
# SPDX-License-Identifier: Apache-2.0

description: WCH LPTIM (Low Power Timer)

compatible: "wch,ch32-lptim"

include: base.yaml

properties:
  reg:
    required: true

  interrupts:
    required: true

  clocks:
    required: true

  wch,clock-source:
    type: int
    default: 0
    enum:
      - 0 # PCLK1
      - 1 # HSI
      - 2 # LSE
      - 3 # LSI
    description: |
      Select the LPTIM internal clock source.
      0: PCLK1
      1: HSI
      2: LSE
      3: LSI

  wch,prescaler:
    type: int
    default: 1
    enum:
      - 1
      - 2
      - 4
      - 8
      - 16
      - 32
      - 64
      - 128
    description: |
      Clock divider at the input of the LPTIM clock.
```

## dts/bindings/usb/wch,usbfs.yaml
```yaml
# Copyright (c) 2025 Scott King
# SPDX-License-Identifier: Apache-2.0

description: WCH USB Full-Speed Device Controller

compatible: "wch,usbfs"

include: [usb-ep.yaml, pinctrl-device.yaml]
```

## dts/bindings/usb/wch,usbhs.yaml
```yaml
# Copyright (c) 2026 Scott King
# SPDX-License-Identifier: Apache-2.0

description: WCH USB High-Speed Device Controller

compatible: "wch,usbhs"

include: [usb-ep.yaml, pinctrl-device.yaml]
```

## dts/bindings/usb/wch,usbpd.yaml
```yaml
# Copyright (c) 2026 Scott King
# SPDX-License-Identifier: Apache-2.0

description: WCH USB Power Delivery Controller

compatible: "wch,ch32-usbpd"

include: [base.yaml, pinctrl-device.yaml]

properties:
  reg:
    required: true

  interrupts:
    required: true

  clocks:
    required: true

  "#address-cells":
    const: 1

  "#size-cells":
    const: 0
```

## dts/bindings/usbc/wch,ch32x035-ucpd.yaml
```yaml
# Copyright (c) 2024 Nanjing Qinheng Microelectronics Co., Ltd.
# SPDX-License-Identifier: Apache-2.0

description: WCH CH32X035 USB Power Delivery Controller

compatible: "wch,ch32x035-ucpd"

include: [base.yaml, pinctrl-device.yaml]

properties:
  reg:
    required: true

  interrupts:
    required: true

  clocks:
    required: true
```

## dts/bindings/watchdog/wch,ch32-watchdog.yaml
```yaml
# Copyright (c) 2019, Linaro Limited
# SPDX-License-Identifier: Apache-2.0

description: STM32 watchdog

compatible: "wch,ch32-watchdog"

include: base.yaml

properties:
  reg:
    required: true
```

## dts/bindings/watchdog/wch,ch32-wwdg.yaml
```yaml
description: WCH Window Watchdog

compatible: "wch,ch32-wwdg"

include: base.yaml

properties:
  reg:
    required: true
```

## samples/subsys/usb/console/boards/ch32l103_evt.conf
```kconfig
CONFIG_USB_DEVICE_STACK_NEXT=y
CONFIG_USB_DEVICE_VID=0x1a86
CONFIG_USB_DEVICE_PID=0x7523
CONFIG_USB_DEVICE_PRODUCT="CH32L103 USB CDC"
CONFIG_UDC_WCH_USBFS=y
CONFIG_UDC_DRIVER_LOG_LEVEL_INF=y
CONFIG_USB_DEVICE_INITIALIZE_AT_BOOT=y
```

## soc/wch/ch32v/qingke_v4c/Kconfig
```kconfig
# Copyright (c) 2024 Michael Hope
# Copyright (c) 2024 Jianxiong Gu
# SPDX-License-Identifier: Apache-2.0

config SOC_SERIES_QINGKE_V4C
	bool
	depends on SOC_FAMILY_CH32V
	select RISCV
	select RISCV_ISA_RV32I
	select RISCV_ISA_EXT_M
	select RISCV_ISA_EXT_A
	select RISCV_ISA_EXT_C
	select RISCV_ISA_EXT_ZICSR
	select RISCV_ISA_EXT_ZIFENCEI
	select XIP
```

## soc/wch/ch32v/qingke_v4c/Kconfig.defconfig
```kconfig
# Copyright (c) 2024 Michael Hope
# Copyright (c) 2024 Jianxiong Gu
# SPDX-License-Identifier: Apache-2.0

if SOC_SERIES_QINGKE_V4C

config SOC_SERIES
	default "qingke_v4c"

config CLOCK_CONTROL
	default y

rsource "Kconfig.defconfig.*"

endif # SOC_SERIES_QINGKE_V4C
```

## soc/wch/ch32v/qingke_v4c/Kconfig.defconfig.ch32x035
```kconfig
# Copyright (c) 2025 MASSDRIVER EI (massdriver.space)
# SPDX-License-Identifier: Apache-2.0

if SOC_CH32X035

config SYS_CLOCK_HW_CYCLES_PER_SEC
	default 48000000

config NUM_IRQS
	default 64

config FLASH_SIZE
	default 62

config FLASH_BASE_ADDRESS
	default 0x08000000

config SRAM_SIZE
	default 20

config SRAM_BASE_ADDRESS
	default 0x20000000

endif # SOC_CH32X035
```

## soc/wch/ch32v/qingke_v4c/Kconfig.soc
```kconfig
# Copyright (c) 2024 Michael Hope
# Copyright (c) 2024 Jianxiong Gu
# SPDX-License-Identifier: Apache-2.0

rsource "Kconfig.soc.*"
```
