## CMakeLists.txt
```
# SPDX-License-Identifier: Apache-2.0

cmake_minimum_required(VERSION 3.20.0)

find_package(Zephyr REQUIRED HINTS $ENV{ZEPHYR_BASE})
project(hello_world)

target_sources(app PRIVATE src/main.c ../../../../drivers/console/sdi_console.c)
target_include_directories(app PRIVATE ../../../../include/zephyr/drivers/console)
```

## prj.conf
```kconfig
CONFIG_WCH_LPTIM_TIMER=y
CONFIG_CH32V00X_SYSTICK=n
CONFIG_SYS_CLOCK_HW_CYCLES_PER_SEC=40000
CONFIG_SYS_CLOCK_TICKS_PER_SEC=100

# For debugging
CONFIG_STDOUT_CONSOLE=y
CONFIG_SDI_CONSOLE=y
```

## boards/ch32l103_evt.conf
```kconfig
CONFIG_LOG=y
CONFIG_CBPRINTF_FP_SUPPORT=y
```

## app.overlay
```dts
&usart1 {
    current-speed = <9600>;
};

/ {
    leds {
        compatible = "gpio-leds";
        blue_led: led_0 {
            gpios = <&gpioc 13 GPIO_ACTIVE_LOW>;
            label = "Blue LED";
        };
    };
};
```

## src/main.c
```c
#include <zephyr/kernel.h>
#include <sdi_console.h>

int main(void)
{
	sdi_console_init();
	sdi_console_puts("WCH LPTIM System Timer Test\n");
	sdi_console_printf("Cycles per sec: %u\n", sys_clock_hw_cycles_per_sec());

	while (1) {
		sdi_console_printf("Uptime: %lld ms\n", k_uptime_get());
		k_msleep(1000);
	}

	return 0;
}
```
