## boards/wch/ch32l103_evt/Kconfig
```kconfig
# Copyright (c) 2026 Scott King
# SPDX-License-Identifier: Apache-2.0

config BOARD_CH32L103_EVT
	bool "WCH CH32L103 Evaluation Board"
	depends on SOC_CH32L103
```

## boards/wch/ch32l103_evt/board.yml
```yaml
board:
  name: ch32l103_evt
  full_name: WCH CH32L103 EVT
  vendor: wch
  socs:
    - name: ch32l103
```

## drivers/can/Kconfig.wch
```kconfig
# Copyright (c) 2025 Scott King
# SPDX-License-Identifier: Apache-2.0

config CAN_WCH
	bool "WCH CAN Driver"
	default y
	depends on DT_HAS_WCH_CH32_CAN_ENABLED
	help
	  Enable the WCH CH32 CAN driver.

if CAN_WCH

config CAN_MAX_FILTER
	int "Maximum number of concurrent active filters"
	default 5
	range 1 14
	help
	  Defines the maximum number of concurrent active filters.

endif
```

## drivers/counter/Kconfig.wch
```kconfig
# Copyright (c) 2026 Scott King
# SPDX-License-Identifier: Apache-2.0

config COUNTER_WCH_LPTIM
	bool "WCH LPTIM counter driver"
	default y
	depends on DT_HAS_WCH_CH32_LPTIM_ENABLED
	help
	  Enable support for the WCH LPTIM counter driver.
```

## drivers/opamp/Kconfig.wch
```kconfig
# WCH Op-Amp configuration options

config OPAMP_WCH
	bool "WCH Op-Amp driver"
	default y
	depends on DT_HAS_WCH_OPA_ENABLED
    select MFD_WCH_OPACMP
	help
	  Enable Op-Amp driver for WCH.
```

## drivers/timer/Kconfig.wch_lptim
```kconfig
# WCH LPTIM timer configuration options

# Copyright (c) 2024 Scott King
# SPDX-License-Identifier: Apache-2.0

config WCH_LPTIM_TIMER
	bool "WCH LPTIM timer"
	depends on DT_HAS_WCH_CH32_LPTIM_ENABLED
	select TICKLESS_CAPABLE
	help
	  Enables the WCH LPTIM timer.
```

## dts/bindings/console/wch,sdi-console.yaml
```yaml
description: WCH SDI Console

compatible: "wch,sdi-console"

include: base.yaml

properties:
  reg:
    required: true
    description: |
      Base address of the DMDATA0 register.
      For most QingKe cores (V2/V3/V4), this is 0xe0000380.
      For V003/X035 (partially), it might differ.
```

## soc/wch/ch32v/qingke_v4c/Kconfig.defconfig.ch32l103
```kconfig
# Copyright (c) 2026 Scott King
# SPDX-License-Identifier: Apache-2.0

if SOC_CH32L103

config SOC
	default "ch32l103"

config SYS_CLOCK_HW_CYCLES_PER_SEC
	default 72000000

config NUM_IRQS
	default 82

config VECTOR_TABLE_SIZE
	default 82

config FLASH_SIZE
	default 64

config FLASH_BASE_ADDRESS
	default 0x08000000

config SRAM_SIZE
	default 20

config SRAM_BASE_ADDRESS
	default 0x20000000

endif # SOC_CH32L103
```

## soc/wch/ch32v/qingke_v4c/Kconfig.soc.ch32l103
```kconfig
# Copyright (c) 2026 Scott King
# SPDX-License-Identifier: Apache-2.0

config SOC_CH32L103
	bool "CH32L103"
	select SOC_FAMILY_CH32V
	select SOC_SERIES_QINGKE_V4C
	select HAS_PM

config SOC
	default "ch32l103" if SOC_CH32L103
```
