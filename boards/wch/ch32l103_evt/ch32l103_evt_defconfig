## boards/wch/ch32l103_evt/ch32l103_evt_defconfig
```kconfig
CONFIG_SOC_CH32L103=y
CONFIG_BOARD_CH32L103_EVT=y
CONFIG_CONSOLE=y
CONFIG_SDI_CONSOLE=y
# CONFIG_UART_CONSOLE is not set
CONFIG_SERIAL=y
CONFIG_GPIO=y
CONFIG_MFD=y
CONFIG_OPAMP=y
CONFIG_COMPARATOR=y
CONFIG_UART_WCH_USART_DMA=y
```

## boards/wch/ch32v307_evt/Kconfig
```kconfig
# Copyright (c) 2026 Scott King
# SPDX-License-Identifier: Apache-2.0

config BOARD_CH32V307_EVT
	bool "WCH CH32V307 Evaluation Board"
	select SOC_CH32V307
```

## boards/wch/ch32x035_evt/Kconfig
```kconfig
# Copyright (c) 2025 MASSDRIVER EI (massdriver.space)
# SPDX-License-Identifier: Apache-2.0

config BOARD_CH32X035_EVT
	bool "WCH CH32X035 EVT"
	depends on SOC_CH32X035
```

## boards/wch/ch32x035_evt/board.yml
```yaml
# Copyright (c) 2025 MASSDRIVER EI (massdriver.space)
# SPDX-License-Identifier: Apache-2.0

board:
  name: ch32x035_evt
  vendor: wch
  socs:
    - name: ch32x035
```

## boards/wch/ch32x035_evt/ch32x035_evt_defconfig
```kconfig
# Copyright (c) 2025 MASSDRIVER EI (massdriver.space)
# SPDX-License-Identifier: Apache-2.0

# Board Configuration
CONFIG_BOARD_CH32X035_EVT=y

# SoC Configuration  
CONFIG_SOC_CH32X035=y

# XIP from flash
CONFIG_XIP=y

# Console
CONFIG_CONSOLE=y
CONFIG_SERIAL=y
CONFIG_UART_CONSOLE=y

# GPIO
CONFIG_GPIO=y
CONFIG_PM=y
```

## drivers/adc/Kconfig.wch
```kconfig
# Copyright (c) Michael Hope <michaelh@juju.nz>
# SPDX-License-Identifier: Apache-2.0

config ADC_WCH
	bool "WCH CH32 ADC driver"
	default y
	depends on DT_HAS_WCH_ADC_ENABLED
	select ADC_CONTEXT_NET_PKT_BUFFER
	help
	  Enable WCH CH32 ADC driver.

config ADC_WCH_TOUCHKEY
	bool "WCH CH32 Touchkey driver"
	default y
	depends on DT_HAS_WCH_CH32_TOUCHKEY_ENABLED
	select ADC_CONTEXT_NET_PKT_BUFFER
	help
	  Enable WCH CH32 Touchkey driver.

config ADC_WCH_DMA
	bool "WCH ADC DMA support"
	depends on ADC_WCH && DMA
	help
	  Enable DMA support for the WCH ADC driver.
```

## drivers/bbram/Kconfig.wch
```kconfig
# Copyright (c) 2024 WCH
# SPDX-License-Identifier: Apache-2.0

config BBRAM_WCH
	bool "WCH BKP (Batter-backed registers) driver"
	default y
	depends on DT_HAS_WCH_CH32_BBRAM_ENABLED
	help
	  Enable the WCH Battery-Backed RAM driver.
```

## drivers/clock_control/Kconfig.ch32x035
```kconfig
# Copyright (c) 2025 MASSDRIVER EI (massdriver.space)
# SPDX-License-Identifier: Apache-2.0

config CLOCK_CONTROL_CH32X035
	bool "WCH CH32X035 clock control driver"
	default y
	depends on DT_HAS_WCH_CH32X035_RCC_ENABLED
	help
	  Enable clock control for WCH CH32X035 microcontrollers.
	  The CH32X035 uses a fixed 48MHz internal HSI oscillator
	  with no PLL. This driver enables/disables peripheral clocks
	  on the AHB, APB1, and APB2 buses.
```

## drivers/comparator/Kconfig.wch_cmp
```kconfig
# WCH Comparator driver configuration options

config COMPARATOR_WCH
	bool "WCH Comparator driver"
	default y
	depends on DT_HAS_WCH_CMP_ENABLED
	help
	  Enable the WCH Comparator driver.
```

## drivers/dma/Kconfig.wch
```kconfig
# Copyright (c) 2024 Paul Wedeck <paulwedeck@gmail.com>
# Copyright (c) 2026 Scott King
# SPDX-License-Identifier: Apache-2.0

config DMA_CH32
	bool "WCH CH32 DMA controller driver"
	default y
	depends on DT_HAS_WCH_DMA_ENABLED
	select DMA_HAS_CHANNEL_FILTER
	help
	  Enable DMA support for WCH CH32V/CH32L/CH32X series MCUs.
	  This driver supports the DMA controller found on CH32V003,
	  CH32V103, CH32V203, CH32V307, CH32L103, CH32X035, and similar parts.
	  Each DMA controller instance (DMA1, DMA2) is handled separately.
```

## drivers/flash/Kconfig.wch
```kconfig
# Copyright (c) 2026 Scott King
# SPDX-License-Identifier: Apache-2.0

config SOC_FLASH_WCH
	bool "WCH Flash driver"
	default y
	depends on DT_HAS_WCH_CH32_FLASH_CONTROLLER_ENABLED
	select FLASH_HAS_PAGE_LAYOUT
	select FLASH_HAS_DRIVER_ENABLED
	help
	  Enable WCH Flash driver.
```

## drivers/mfd/Kconfig.wch_opacmp
```kconfig
# Copyright (c) 2024 WCH
# SPDX-License-Identifier: Apache-2.0

config MFD_WCH_OPACMP
    bool "WCH OPACMP MFD driver"
    default y
    depends on DT_HAS_WCH_OPACMP_ENABLED
    help
      Enable MFD driver for WCH OPACMP peripheral.

config WCH_OPA
    bool "WCH OPA driver"
    default y
    depends on DT_HAS_WCH_OPA_ENABLED
    depends on MFD_WCH_OPACMP
    help
      Enable OPA driver for WCH.
```

## drivers/opamp/Kconfig.wch_opamp
```kconfig
# WCH OPA driver configuration options

config OPAMP_WCH
	bool "WCH Operational Amplifier (OPA) driver"
	default y
	depends on DT_HAS_WCH_OPA_ENABLED
	help
	  Enable the WCH OPA driver.
```

## drivers/pinctrl/Kconfig.ch32x035
```kconfig
# Copyright (c) 2025 MASSDRIVER EI (massdriver.space)
# SPDX-License-Identifier: Apache-2.0

config PINCTRL_CH32X035
	bool "WCH CH32X035 pin controller driver"
	default y
	depends on DT_HAS_WCH_CH32X035_AFIO_ENABLED
	help
	  WCH CH32X035 pin controller driver.
	  Configures GPIO pins for alternate functions.
```

## drivers/pm/Kconfig
```kconfig
# Power Management Driver configuration options

# Copyright (c) 2026 Scott King
# SPDX-License-Identifier: Apache-2.0

menuconfig PM_DRIVERS
	bool "Power Management Drivers"
	help
	  Enable support for Power Management Drivers.

if PM_DRIVERS

config PM_WCH
	bool "WCH Power Management [PWR] driver"
	default y
	depends on DT_HAS_WCH_PWR_ENABLED
	help
	  Enable support for the WCH Power Management [PWR] driver.

config PM_WCH_INIT_PRIORITY
	int "WCH PWR driver initialization priority"
	default 40
	depends on PM_WCH
	help
	  Initialization priority for the WCH PWR driver.

endif # PM_DRIVERS
```

## drivers/pwm/Kconfig.wch
```kconfig
# Copyright (c) 2025 Michael Hope <michaelh@juju.nz>
# SPDX-License-Identifier: Apache-2.0

config PWM_WCH_GPTM
	bool "WCH General-purpose Timer (GPTM) for PWM"
	default y
	depends on DT_HAS_WCH_GPTM_PWM_ENABLED
	select PINCTRL
	help
	  PWM driver for the WCH GPTM, such as TIM2 on the CH32V003.

config PWM_WCH_LPTIM
	bool "WCH LPTIM PWM driver"
	default y
	depends on DT_HAS_WCH_CH32_LPTIM_PWM_ENABLED
	depends on !WCH_LPTIM_TIMER
	select PINCTRL
	help
	  Enable the WCH LPTIM PWM driver.
```

## drivers/rtc/Kconfig.wch
```kconfig
# Copyright (c) 2024 WCH
# SPDX-License-Identifier: Apache-2.0

config RTC_WCH
	bool "WCH RTC Driver"
	default y
	depends on DT_HAS_WCH_CH32_RTC_ENABLED
	help
	  Enable WCH RTC driver.
```

## drivers/serial/Kconfig.wch_usart
```kconfig
# Copyright (c) 2024 Google LLC.
# SPDX-License-Identifier: Apache-2.0

config UART_WCH_USART
	bool "WCH USART driver"
	default y
	depends on DT_HAS_WCH_USART_ENABLED
	select SERIAL_HAS_DRIVER
	select SERIAL_SUPPORT_INTERRUPT
	select SERIAL_SUPPORT_ASYNC
	select PINCTRL
	help
	  This option enables the USART driver for WCH SoC families.

config UART_WCH_USART_DMA
	bool "DMA support for WCH USART driver"
	depends on UART_WCH_USART
	select DMA
	select UART_ASYNC_API
	help
	  This option enables the DMA support for the USART driver.
```

## drivers/usb/udc/Kconfig.wch
```kconfig
# Copyright (c) 2025 Scott King
# SPDX-License-Identifier: Apache-2.0

config UDC_WCH_USBFS
	bool "WCH USBFS Device Controller driver"
	default y
	depends on DT_HAS_WCH_USBFS_ENABLED
	help
	  WCH USB Full-Speed Device Controller driver.

config UDC_WCH_USBHS
	bool "WCH USBHS Device Controller driver"
	default y
	depends on DT_HAS_WCH_USBHS_ENABLED
	select UDC_DRIVER_HAS_HIGH_SPEED_SUPPORT
	help
	  WCH USB High-Speed Device Controller driver.
```

## drivers/usb_c/tcpc/Kconfig.tcpc_ch32x035
```kconfig
# Copyright (c) 2024 Nanjing Qinheng Microelectronics Co., Ltd.
# SPDX-License-Identifier: Apache-2.0

config USBC_TCPC_CH32X035
	bool "WCH CH32X035 USB Power Delivery Controller Driver"
	default y
	depends on DT_HAS_WCH_CH32X035_UCPD_ENABLED
	help
	  Enable TCPC driver for WCH CH32X035.
```

## drivers/usb_c/tcpc/Kconfig.tcpc_wch
```kconfig
# Copyright (c) 2024 Nanjing Qinheng Microelectronics Co., Ltd.
# SPDX-License-Identifier: Apache-2.0

config USBC_TCPC_WCH
	bool "WCH USB Power Delivery Controller Driver"
	default y
	depends on DT_HAS_WCH_CH32_USBPD_ENABLED
	help
	  Enable TCPC driver for WCH CH32 series (CH32X035, CH32L103).
```

## drivers/watchdog/Kconfig.wch
```kconfig
config WDT_WCH_IWDG
	bool "WCH Independent Watchdog (IWDG) Driver"
	default y
	depends on DT_HAS_WCH_CH32_WATCHDOG_ENABLED
	help
	  Enable IWDG driver for WCH CH32 MCUs.

config WDT_WCH_WWDG
	bool "WCH Window Watchdog (WWDG) Driver"
	default y
	depends on DT_HAS_WCH_CH32_WWDG_ENABLED
	help
	  Enable WWDG driver for WCH CH32 MCUs.
```

## dts/bindings/adc/wch,adc.yaml
```yaml
# Copyright (c) 2025 Michael Hope <michaelh@juju.nz>
# SPDX-License-Identifier: Apache-2.0

description: WCH ADC

compatible: "wch,adc"

include: [adc-controller.yaml, pinctrl-device.yaml]

properties:
  reg:
    required: true

  interrupts:
    required: true

  clocks:
    required: true

  vref-mv:
    type: int
    default: 3300
    description: |
      Reference voltage in mV. This is typically VDD.

  pinctrl-0:
    required: true

  pinctrl-names:
    required: true

  "#io-channel-cells":
    const: 1

  dmas:
    description: DMA channels for ADC data transfer

  dma-names:
    description: DMA channel names

io-channel-cells:
  - input
```
