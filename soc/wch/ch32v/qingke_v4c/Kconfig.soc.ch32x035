## soc/wch/ch32v/qingke_v4c/Kconfig.soc.ch32x035
```kconfig
# Copyright (c) 2025 MASSDRIVER EI (massdriver.space)
# SPDX-License-Identifier: Apache-2.0

config SOC_CH32X035
	bool "CH32X035"
	select SOC_FAMILY_CH32V
	select SOC_SERIES_QINGKE_V4C
	select HAS_PM

config SOC
	default "ch32x035" if SOC_CH32X035
```

## soc/wch/ch32v/qingke_v4f/Kconfig.defconfig
```kconfig
# Copyright (c) 2025 Bootlin
# SPDX-License-Identifier: Apache-2.0

if SOC_SERIES_QINGKE_V4F

config SOC_SERIES
	default "qingke_v4f"

config SYS_CLOCK_HW_CYCLES_PER_SEC
	default $(dt_node_int_prop_int,/cpus/cpu@0,clock-frequency)

config CLOCK_CONTROL
	default y

rsource "Kconfig.defconfig.*"

endif # SOC_SERIES_QINGKE_V4F
```

## soc/wch/ch32v/qingke_v4f/Kconfig.soc.ch32v307
```kconfig
# Copyright (c) 2025 Thomas Boje
# SPDX-License-Identifier: Apache-2.0

config SOC_CH32V307
	bool
	select SOC_SERIES_QINGKE_V4F
	select SOC_FAMILY_CH32V
	select RISCV_ISA_RV32IMAFDC

config SOC
	default "ch32v307" if SOC_CH32V307
```

## tests/board/ch32x035/tcpc/testcase.yaml
```yaml
tests:
  drivers.tcpc.ch32x035:
    tags: drivers tcpc
    platform_allow: ch32x035_evt
    integration_platforms:
      - ch32x035_evt
```
